## main/Kconfig.projbuild
```kconfig
menu "Application Configuration"

	config ESP_WIFI_SSID
		string "WiFi SSID"
		default "myssid"
		help
			SSID (network name) for the example to connect to.

	config ESP_WIFI_PASSWORD
		string "WiFi Password"
		default "mypassword"
		help
			WiFi password (WPA or WPA2) for the example to use.

	config ESP_MAXIMUM_RETRY
		int "Maximum retry"
		default 5
		help
			Set the Maximum retry to avoid station reconnecting to the AP unlimited when the AP is really inexistent.

	config ESP_WOEID
		int "Where On Earth IDentifier"
		default 1118370
		help
			Set the WOEID of the place where you want the weather forecast.

	config ESP_UPDATE_PERIOD
		int "Update interval(Minute)"
		range 10 1440
		default 10
		help
			Set the automatic update interval.

	choice ESP_FONT
		bool "Select font"
		default ESP_FONT_GOTHIC
		help
			Select font.

		config ESP_FONT_GOTHIC
			bool "Gothic"
		config ESP_FONT_MINCYO
			bool "Mincyo"
	endchoice


endmenu
```
